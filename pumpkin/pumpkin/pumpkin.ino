#include <ESP32Servo.h>

#define PIN_AUDIO 2
#define PIN_SERVO 1
#define R1 3
#define B1 4
#define G1 5
#define R2 6
#define B2 7
#define G2 8

// ===== Servo positions (degrees, 0-180) =====
static const int SERVO_OPEN   = 180;
static const int SERVO_CLOSED = 0;

// ===== Paste your generated sound array here =====
const uint8_t PROGMEM soundData[] = {
0x7F,0x7F,0x7F,0x7F,0x7F,0x7F,0x7F,0x7F,0x7F,0x7F,0x7F,0x7F,0x7F,0x7F,0x7F,0x7F,
0x7F,0x7F,0x7F,0x7F,0x7F,0x7F,0x7F,0x7F,0x7F,0x7F,0x7F,0x7F,0x7F,0x7F,0x7F,0x7F,
0x7F,0x7F,0x7F,0x7F,0x7F,0x7F,0x7F,0x7F,0x7F,0x7F,0x7F,0x7F,0x7F,0x7F,0x7F,0x7F,
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0x81,0x82,0x81,0x7E,0x7E,0x80,0x81,0x7F,0x7B,0x78,0x7C,0x80,0x80,0x7D,0x82,0x86,

};
const size_t soundLen = 8000;

const uint32_t CARRIER_HZ = 30000;

Servo myservo;

void setColor(int r, int g, int b) {
  analogWrite(R1, r); analogWrite(G1, g); analogWrite(B1, b);
  analogWrite(R2, r); analogWrite(G2, g); analogWrite(B2, b);
}

void playClip() {
  ledcAttach(PIN_AUDIO, CARRIER_HZ, 8);

  for (size_t i = 0; i < soundLen; i++) {
    ledcWrite(PIN_AUDIO, pgm_read_byte(&soundData[i]));
    delayMicroseconds(125);
  }

  ledcWrite(PIN_AUDIO, 0);
  ledcDetach(PIN_AUDIO);
  pinMode(PIN_AUDIO, OUTPUT);
  digitalWrite(PIN_AUDIO, LOW);
}

void openPlayClose() {
  // 1. Open
  myservo.write(SERVO_OPEN);
  delay(500);                // settle
  myservo.detach();          // cut holding current before audio

  // 2. Play
  playClip();

  // 3. Reattach and close
  myservo.attach(PIN_SERVO, 500, 2400);
  delay(50);
  myservo.write(SERVO_CLOSED);
  delay(500);
}

void setup() {
  Serial.begin(9600);

  myservo.setPeriodHertz(50);
  myservo.attach(PIN_SERVO, 500, 2400);

  pinMode(PIN_AUDIO, OUTPUT);
  digitalWrite(PIN_AUDIO, LOW);

  pinMode(R1, OUTPUT); pinMode(B1, OUTPUT); pinMode(G1, OUTPUT);
  pinMode(R2, OUTPUT); pinMode(B2, OUTPUT); pinMode(G2, OUTPUT);

  setColor(255, 0, 0);
  myservo.write(SERVO_CLOSED);
  Serial.println("Ready. Send START to run sequence, or a number 0-180 to move the servo.");
}

void loop() {
  if (Serial.available() > 0) {
    String cmd = Serial.readStringUntil('\n');
    cmd.trim();
    cmd.toUpperCase();

    if (cmd == "START") {
      Serial.println("START received.");
      setColor(0, 255, 0);
      openPlayClose();
      setColor(255, 0, 0);
      Serial.println("Done.");
    } else if (cmd.length() > 0) {
      int angle = cmd.toInt();
      angle = constrain(angle, 0, 180);
      // Reattach if we detached earlier
      if (!myservo.attached()) {
        myservo.attach(PIN_SERVO, 500, 2400);
      }
      myservo.write(angle);
      Serial.print("Moved to: ");
      Serial.println(angle);
    }
  }
}